## config/west.yml
```yaml
manifest:
  remotes:
    - name: zmkfirmware
      url-base: https://github.com/zmkfirmware
    - name: karuetech                          # <--- add these
      url-base: https://github.com/karuetech   # <---
  projects:
    - name: zmk
      remote: zmkfirmware
      revision: v0.2
      import: app/west.yml
    - name: snake-module                          # <--- and these
      remote: karuetech                        # <---
      revision: master                            # <---
  self:
    path: config
```
